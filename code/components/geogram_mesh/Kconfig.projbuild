## code/components/geogram_mesh/Kconfig.projbuild
```kconfig
menu "Geogram Mesh Networking"

    config GEOGRAM_MESH_ENABLED
        bool "Enable ESP-MESH support"
        default n
        depends on IDF_TARGET_ESP32 || IDF_TARGET_ESP32S2 || IDF_TARGET_ESP32S3 || IDF_TARGET_ESP32C3
        help
            Enable ESP-MESH protocol for multi-node mesh networks.
            When enabled, devices can form a self-organizing mesh network
            and bridge IP traffic between phones connected to different nodes.
            ESP32-C3 is supported with reduced memory limits (see Kconfig options).

    config GEOGRAM_MESH_CHANNEL
        int "Mesh WiFi Channel"
        default 1
        range 1 13
        depends on GEOGRAM_MESH_ENABLED
        help
            WiFi channel for mesh network. All nodes must use the same channel.
            Avoid channels used by nearby WiFi networks for best performance.

    config GEOGRAM_MESH_MAX_LAYER
        int "Maximum mesh tree depth"
        default 6
        range 2 25
        depends on GEOGRAM_MESH_ENABLED
        help
            Maximum depth of the mesh tree topology. Root node is layer 1.
            Larger values allow more nodes but increase latency.
            Use 3 for ESP32-C3 to conserve memory.

    config GEOGRAM_MESH_ROUTE_TABLE_SIZE
        int "Route table size"
        default 50
        range 10 300
        depends on GEOGRAM_MESH_ENABLED
        help
            Maximum number of nodes in the routing table.
            Use 20 for ESP32-C3 to conserve memory.

    config GEOGRAM_MESH_EXTERNAL_AP_MAX_CONN
        int "Max phone connections per node"
        default 4
        range 1 10
        depends on GEOGRAM_MESH_ENABLED
        help
            Maximum number of phones that can connect to each node's SoftAP.
            Use 2 for ESP32-C3 to conserve memory.

    config GEOGRAM_MESH_AP_AUTHMODE
        int "External AP authentication mode"
        default 0
        range 0 4
        depends on GEOGRAM_MESH_ENABLED
        help
            Authentication mode for the external SoftAP:
            0 = Open (no password)
            1 = WEP
            2 = WPA_PSK
            3 = WPA2_PSK
            4 = WPA_WPA2_PSK

    config GEOGRAM_MESH_BRIDGE_BUFFER_SIZE
        int "Bridge packet buffer size"
        default 1500
        range 576 2048
        depends on GEOGRAM_MESH_ENABLED
        help
            Maximum size of IP packets that can be bridged.
            Standard Ethernet MTU is 1500.

    config GEOGRAM_MESH_BRIDGE_QUEUE_SIZE
        int "Bridge packet queue size"
        default 8
        range 4 32
        depends on GEOGRAM_MESH_ENABLED
        help
            Number of packets that can be queued for bridging.
            Larger values improve throughput but use more memory.

endmenu
```

## code/sdkconfig.defaults
```kconfig
# Common ESP-IDF configuration for all Geogram boards
# Based on Waveshare ESP32-S3 ePaper 1.54" example settings

# Target
CONFIG_IDF_TARGET="esp32s3"

# Compiler options
CONFIG_COMPILER_OPTIMIZATION_SIZE=y

# FreeRTOS
CONFIG_FREERTOS_HZ=1000
CONFIG_FREERTOS_USE_TRACE_FACILITY=y

# Log level
CONFIG_LOG_DEFAULT_LEVEL_INFO=y
CONFIG_LOG_DEFAULT_LEVEL=3

# Flash settings
CONFIG_ESPTOOLPY_FLASHMODE_QIO=y
CONFIG_ESPTOOLPY_FLASHSIZE_4MB=y
CONFIG_ESPTOOLPY_FLASHSIZE="4MB"

# Partition table
CONFIG_PARTITION_TABLE_CUSTOM=y
CONFIG_PARTITION_TABLE_CUSTOM_FILENAME="partitions.csv"

# PSRAM / SPIRAM settings (required for LVGL buffer)
CONFIG_SPIRAM=y
CONFIG_SPIRAM_MODE_QUAD=y
CONFIG_SPIRAM_SPEED_80M=y
CONFIG_SPIRAM_BOOT_INIT=y
CONFIG_SPIRAM_USE_MALLOC=y
CONFIG_SPIRAM_MALLOC_ALWAYSINTERNAL=16384
CONFIG_SPIRAM_MALLOC_RESERVE_INTERNAL=32768
CONFIG_SPIRAM_ALLOW_STACK_EXTERNAL_MEMORY=y

# Stack sizes
CONFIG_ESP_MAIN_TASK_STACK_SIZE=8192
CONFIG_ESP_SYSTEM_EVENT_TASK_STACK_SIZE=4096

# Timer task stack sizes (required for ESP-Mesh-Lite phone connections)
# See: https://github.com/espressif/esp-mesh-lite/issues/15
# led_light example uses 4096 as "Temporary Fix for Timer Overflows"
CONFIG_FREERTOS_TIMER_TASK_STACK_DEPTH=4096
CONFIG_ESP_TIMER_TASK_STACK_SIZE=4096

# WiFi
CONFIG_ESP_WIFI_STATIC_RX_BUFFER_NUM=10
CONFIG_ESP_WIFI_DYNAMIC_RX_BUFFER_NUM=32
CONFIG_ESP_WIFI_DYNAMIC_TX_BUFFER_NUM=32

# HTTP Server
CONFIG_HTTPD_MAX_REQ_HDR_LEN=1024
CONFIG_HTTPD_MAX_URI_LEN=512
CONFIG_HTTPD_WS_SUPPORT=y

# LVGL configuration - use external lv_conf.h
CONFIG_LV_CONF_SKIP=n

# FAT filesystem (for potential future use)
CONFIG_FATFS_LFN_HEAP=y

# SSH server authentication
CONFIG_EXAMPLE_ALLOW_PASSWORD_AUTH=y
CONFIG_EXAMPLE_ALLOW_PUBLICKEY_AUTH=n

# mbedTLS threading (required for SSH server libssh)
CONFIG_MBEDTLS_THREADING_C=y
CONFIG_MBEDTLS_THREADING_ALT=n
CONFIG_MBEDTLS_THREADING_PTHREAD=y

# Allow insecure TLS connections (needed for tile downloads without cert verification)
CONFIG_ESP_TLS_INSECURE=y
CONFIG_ESP_TLS_SKIP_SERVER_CERT_VERIFY=y

# LWIP settings (for SSH server compatibility)
CONFIG_LWIP_NETIF_API=y

# ============================================================================
# ESP-Mesh-Lite Configuration
# ============================================================================

# LWIP settings required for mesh-lite
CONFIG_LWIP_IP_FORWARD=y
CONFIG_LWIP_IPV4_NAPT=y

# Bridge configuration
CONFIG_BRIDGE_ENABLE=y
CONFIG_BRIDGE_DATA_FORWARDING_NETIF_SOFTAP=y
CONFIG_BRIDGE_EXTERNAL_NETIF_STATION=y
# SSID for phone/laptop connectivity
# All nodes use same SSID "geogram" for phone auto-connect
# Mesh discovery uses vendor IEs, not SSID matching
CONFIG_BRIDGE_SOFTAP_SSID="geogram"
CONFIG_BRIDGE_SOFTAP_PASSWORD=""
# CONFIG_BRIDGE_SOFTAP_SSID_END_WITH_THE_MAC is not set
CONFIG_BRIDGE_SOFTAP_MAX_CONNECT_NUMBER=4
CONFIG_BRIDGE_ETHERNET_NETIF_ENABLE=n

# Mesh-Lite settings
CONFIG_MESH_LITE_ENABLE=y
# Vendor ID: 'G' (71), 'W' (87) - "GW" for Geogram Wireless
CONFIG_MESH_LITE_VENDOR_ID_0=71
CONFIG_MESH_LITE_VENDOR_ID_1=87
# Mesh ID: 'g' (103) - matches mesh_id[0] in code ('g','e','o','m','s','h')
CONFIG_MESH_LITE_ID=103
CONFIG_MESH_LITE_MAX_ROUTER_NUMBER=3
CONFIG_MESH_LITE_MAXIMUM_LEVEL_ALLOWED=6
CONFIG_JOIN_MESH_WITHOUT_CONFIGURED_WIFI_INFO=y
CONFIG_JOIN_MESH_IGNORE_ROUTER_STATUS=y
CONFIG_DEVICE_CATEGORY="Geogram"
CONFIG_LEAF_NODE=n
CONFIG_MESH_LITE_NODE_INFO_REPORT=y
```
